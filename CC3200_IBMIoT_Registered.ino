// Include external libraries
#include <SPI.h>
#include <WiFi.h>
#include <WifiIPStack.h>
#include <Countdown.h>
#include <MQTTClient.h>
#include <BMA222.h>

// Wireless network parameters
char ssid[] = "YourSSID";          // Your wireless network name also called SSID
char password[] = "Password";       // Your wireless network password

// IBM IoT Foundation Cloud Settings
/* When adding a device on internetofthings.ibmcloud.com the following information will be generated:
    org=<org>
    type=iotsample-ti-energia
    id=<mac>
    auth-method=token
    auth-token=<password>
*/

#define MQTT_MAX_PACKET_SIZE 4096       // Maximum length of MQTT message in bytes
#define IBMSERVERURLLEN  64
#define IBMIOTFSERVERSUFFIX "messaging.internetofthings.ibmcloud.com"

char organization[] = "IBM_IoT_Organisation";     // Your BlueMix Organisation ID
char typeId[] = "iotsample-ti-cc3200";            // Type of device
char pubtopic[] = "iot-2/evt/status/fmt/json";    // MQTT publication topic
char subTopic[] = "iot-2/cmd/+/fmt/json";         // MQTT subscribe topic
char deviceId[] = "5c313e0555cf";                 // Unique device identifier typically the MAC address of the IoT device
char clientId[64];

char mqttAddr[IBMSERVERURLLEN];
int mqttPort = 1883;                              // Port for MQTT connection

// Authentication method. Should be use-token-auth when using authenticated mode
char authMethod[] = "use-token-auth";          
char authToken[] = "token";          // The authentication token generated by your BlueMix application

const char MQTTSTRING[] = "{\"d\":{\"myName\":\"TILaunchPad\",\"temperature\":%.2f,\"ambient\":%.2f,\"X\":%i,\"Y\":%i,\"Z\":%i,\"RSSI\":%i}}";

// Create MAC address and WiFiIPStack objects
MACAddress mac;
  
WifiIPStack ipstack;  
MQTT::Client<WifiIPStack, Countdown, MQTT_MAX_PACKET_SIZE> client(ipstack);

// Define external sensors, inputs and outputs.
#define LEDPIN RED_LED       // Red LED on CC3200 Launchpad
BMA222 accSensor;            // Three axis acceleration sensor

#include <Wire.h>
#include "Adafruit_TMP006.h"
Adafruit_TMP006 tmp006(0x41);

// Function prototypes to call when a message arrives
void callback(char* topic, byte* payload, unsigned int length);
void messageArrived(MQTT::MessageData& md);

 int n = 0;


// Setup function runs once when microprocessor is powered up
void setup() {
  uint8_t macOctets[6];
  
  Serial.begin(115200);          //Initialise serial port for local monitoring on the Serail Monitor via USB
  Serial.print("Attempting to connect to Network named: ");
  Serial.println(ssid);
  
  // Connect to WPA/WPA2 network. Change this line if using open or WEP network:
  WiFi.begin(ssid, password);
  while ( WiFi.status() != WL_CONNECTED) {
    Serial.print(".");         // print dots while we wait to connect
    delay(300);
  }
  
  Serial.println("\nYou're connected to the network");
  Serial.println("Waiting for an ip address");
  
  while (WiFi.localIP() == INADDR_NONE) {
    Serial.print(".");        // print dots while we wait for an ip addresss
    delay(300);
  }

  // We are connected and have an IP address.
  Serial.print("\nIP Address obtained: ");
  Serial.println(WiFi.localIP());

  mac = WiFi.macAddress(macOctets);
  Serial.print("MAC Address: ");
  Serial.println(mac);
  
  // Use MAC Address as deviceId
  sprintf(deviceId, "%02x%02x%02x%02x%02x%02x", macOctets[0], macOctets[1], macOctets[2], macOctets[3], macOctets[4], macOctets[5]);
  Serial.print("deviceId: ");
  Serial.println(deviceId);

  sprintf(clientId, "d:%s:%s:%s", organization, typeId, deviceId);
  sprintf(mqttAddr, "%s.%s", organization, IBMIOTFSERVERSUFFIX);

  if (!tmp006.begin()) {
    Serial.println("No sensor found");
    while (1);
  }
  
  // start the accel sensor
  accSensor.begin();
  uint8_t chipID = accSensor.chipID();
  Serial.print("ChipID: ");
  Serial.println(chipID);
  

}

// Main loop. Runs continuously
void loop() {
  int rc = -1;
  
  // If the MQTT service is not connected then open connection
  if (!client.isConnected()) {
    Serial.print("Connecting to ");
    Serial.print(mqttAddr);
    Serial.print(":");
    Serial.println(mqttPort);
    Serial.print("With client id: ");
    Serial.println(clientId);
    
    while (rc != 0) {
      rc = ipstack.connect(mqttAddr, mqttPort);
    }

    MQTTPacket_connectData connectData = MQTTPacket_connectData_initializer;
    connectData.MQTTVersion = 3.1;
    connectData.clientID.cstring = clientId;
    connectData.username.cstring = authMethod;
    connectData.password.cstring = authToken;
    connectData.keepAliveInterval = 10;
    
    rc = -1;
    while ((rc = client.connect(connectData)) != 0);
    Serial.println("Connected\n");
    
    Serial.print("Subscribing to topic: ");
    Serial.println(subTopic);
    
    // Unsubscribe the topic, if it had subscribed it before.
    client.unsubscribe(subTopic);
    // Try to subscribe for commands from IBM Bluemix MQTT cloud server
    // messageArrived - function that is called when a MQTT message is received
    rc = client.subscribe(subTopic, MQTT::QOS0, messageArrived);
    if (rc != 0) {
      Serial.print("Subscribe failed with return code : ");
      Serial.println(rc);
    } else {
      Serial.println("Subscribe success\n");
    }
  }

// Poll Sensors and Publish JSON data to MQTT service
  Serial.print("Publishing: ");
  Serial.print(n++);
  char string[64]; // = aJson.print(json);   // Convert JSON data to MQTT string
  sprintf(string, MQTTSTRING, tmp006.readObjTempC(), tmp006.readDieTempC(), accSensor.readXData(), accSensor.readYData(),accSensor.readZData(),-WiFi.RSSI());
  Serial.println(string);             // Print MQTT string to serial terminal
  
  // Create MQTT message
  MQTT::Message message;              
  message.qos = MQTT::QOS0; 
  message.retained = false;
  message.payload = string; 
  message.payloadlen = strlen(string);
  
  // Publish MQTT message
  rc = client.publish(pubtopic, message);
  if (rc != 0) {
    Serial.print("Message publish failed with return code : ");
    Serial.println(rc);
  }
  
  // Wait for one second before publishing again
  // This will also service any incoming messages
  client.yield(2000);
}

void callback(char* topic, byte* payload, unsigned int length) {
  Serial.println("Message has arrived");
  
  char * msg = (char *)malloc(length * sizeof(char));   // Allocate memory for incoming message
  int count = 0;
  for(count = 0 ; count < length ; count++) {
    msg[count] = payload[count];
  }
  msg[count] = '\0';
  Serial.println(msg);
  
  if(length > 0) {
    digitalWrite(LEDPIN, HIGH);
    delay(1000);
    digitalWrite(LEDPIN, LOW);  
  }

  free(msg);                     //Free up memory allocated to message
}

void messageArrived(MQTT::MessageData& md) {
  Serial.print("Message Received\t");
    MQTT::Message &message = md.message;
    int topicLen = strlen(md.topicName.lenstring.data) + 1;
//    char* topic = new char[topicLen];
    char * topic = (char *)malloc(topicLen * sizeof(char));
    topic = md.topicName.lenstring.data;
    topic[topicLen] = '\0';
    
    int payloadLen = message.payloadlen + 1;
//    char* payload = new char[payloadLen];
    char * payload = (char*)message.payload;
    payload[payloadLen] = '\0';
    
    String topicStr = topic;
    String payloadStr = payload;
    
    //Command topic: iot-2/cmd/blink/fmt/json

    if(strstr(topic, "/cmd/blink") != NULL) {
      Serial.print("Command IS Supported : ");
      Serial.print(payload);
      Serial.println("\t.....");
      
      pinMode(LEDPIN, OUTPUT);
      
      //Blink twice
      for(int i = 0 ; i < 2 ; i++ ) {
        digitalWrite(LEDPIN, HIGH);
        delay(250);
        digitalWrite(LEDPIN, LOW);
        delay(250);
      }
    } else {
      Serial.println("Command Not Supported:");            
    }
}

